//! @addtogroup Main
//! @brief main file
//! @{
//!
//****************************************************************************/
//! @file main.c
//! @brief Initialisation file
//! @author Savindra Kumar(savindran1989@gmail.com)
//! @bug No known bugs.
//!
//****************************************************************************/
//****************************************************************************/
//                           Includes
//****************************************************************************/
//standard header files
#include <stdbool.h>
#include <stdint.h>
//user defined header files
#include "init.h"
#include "cli.h"
#include "uart_app.h"
#include "stack_monitor.h"

//****************************************************************************/
//                           Defines and typedefs
//****************************************************************************/
#define TX_BUF_SIZE     256

//****************************************************************************/
//                           Private Functions
//****************************************************************************/

//****************************************************************************/
//                           external variables
//****************************************************************************/

//****************************************************************************/
//                           Private variables
//****************************************************************************/


//****************************************************************************/
//                    G L O B A L  F U N C T I O N S
//****************************************************************************/
int main()
{
    char txBuf[TX_BUF_SIZE];

    StackMonitorInit();
    Init();
    UARTInit();
    cli_Init(txBuf);
    UARTPrint(txBuf);

    //loop forever
    while (1)
    {
       bool bIsCmdProcess = false;
       uint8_t dataByte = 0;
       
       int bytes_rec = GetUARTData(&dataByte);

        if (bytes_rec > 0)
        {
            bIsCmdProcess = cli_ProcessCmd( (char const*)&dataByte, bytes_rec, txBuf);

            if (bIsCmdProcess)
            {
                UARTPrint(txBuf);
                cli_ResetBuffer(txBuf);
                UARTPrint(txBuf);
            }//end if
        }//end if       
    }
   
}//end main


/******************************************************************************
 *                           L O C A L  F U N C T I O N S
 *****************************************************************************/

/******************************************************************************
 *                             End of file
 ******************************************************************************/
/** @}*/